// SPDX-License-Identifier: GPL-2.0

/ {
	/* These properties are required by S-BOOT. */
	model_info-chip = <7870>;
	model_info-hw_rev = <0>;
	model_info-hw_rev_end = <255>;

	/*
	 * S-BOOT will populate the memory nodes stated below. Existing
	 * values redefine the safe memory requirements as stated in upstream
	 * device tree, in separate nodes for each bank.
	 */
	memory@40000000 {
		device_type = "memory";
		reg = <0x0 0x40000000 0x3e400000>;
	};

	memory@80000000 {
		device_type = "memory";
		reg = <0x0 0x80000000 0x40000000>;
	};

	memory@100000000 {
		device_type = "memory";
		reg = <0x1 0x00000000 0x00000000>;
	};
};
